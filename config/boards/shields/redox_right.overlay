/*
 * Copyright (c) 2021 The ZMK Contributors
 *
 * SPDX-License-Identifier: MIT
 */

#include "redox.dtsi"

&default_transform {
    col-offset = <7>;
};

&kscan0 {
    //col-gpios
    //    = <&pro_micro 10 GPIO_ACTIVE_HIGH>
    //    , <&pro_micro 16 GPIO_ACTIVE_HIGH>
    //    , <&pro_micro 14 GPIO_ACTIVE_HIGH>
    //    , <&pro_micro 15 GPIO_ACTIVE_HIGH>
    //    , <&pro_micro 18 GPIO_ACTIVE_HIGH>
    //    , <&pro_micro 19 GPIO_ACTIVE_HIGH>
    //    , <&pro_micro 20 GPIO_ACTIVE_HIGH>
    //    ;
    col-gpios
        = <&gpio1 06 GPIO_ACTIVE_HIGH> // -- left: (
        , <&gpio1 07 GPIO_ACTIVE_HIGH> // -- left: 5
        , <&gpio1 02 GPIO_ACTIVE_HIGH> // -- left: 4
        , <&gpio1 01 GPIO_ACTIVE_HIGH> // -- left: 3
        , <&gpio0 31 GPIO_ACTIVE_HIGH> // -- left: 2
        , <&gpio0 29 GPIO_ACTIVE_HIGH> // -- left: 1
        , <&gpio0 02 GPIO_ACTIVE_HIGH> // -- left: ESC
        ;
};


