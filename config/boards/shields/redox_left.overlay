/*
 * Copyright (c) 2021 The ZMK Contributors
 *
 * SPDX-License-Identifier: MIT
 */

#include "redox.dtsi"

&kscan0 {
    //col-gpios
    //    = <&pro_micro 20 GPIO_ACTIVE_HIGH>
    //    , <&pro_micro 19 GPIO_ACTIVE_HIGH>
    //    , <&pro_micro 18 GPIO_ACTIVE_HIGH>
    //    , <&pro_micro 15 GPIO_ACTIVE_HIGH>
    //    , <&pro_micro 14 GPIO_ACTIVE_HIGH>
    //    , <&pro_micro 16 GPIO_ACTIVE_HIGH>
    //    , <&pro_micro 10 GPIO_ACTIVE_HIGH>
    //    ;
    col-gpios
        = <&gpio0 02 GPIO_ACTIVE_HIGH> // ESC
        , <&gpio0 29 GPIO_ACTIVE_HIGH> // 1
        , <&gpio0 31 GPIO_ACTIVE_HIGH> // 2
        , <&gpio1 01 GPIO_ACTIVE_HIGH> // 3
        , <&gpio1 02 GPIO_ACTIVE_HIGH> // 4
        , <&gpio1 07 GPIO_ACTIVE_HIGH> // 5
        , <&gpio1 06 GPIO_ACTIVE_HIGH> // (
        ;
};

